#include <ESP8266WiFi.h>
#include <ESP8266WebServer.h>
#include <ESP8266HTTPUpdateServer.h>
#include <ESP8266mDNS.h>
#include <WiFiManager.h>
#include <ArduinoJson.h>
#include <PubSubClient.h>
#include <ModbusMaster.h>
#include <SoftwareSerial.h>
#include <EEPROM.h>
#include "relay_controller.h"

// 缁х數鍣ㄥ紩鑴氬畾涔?(JDQ0-3)
#define RELAY1_PIN 12  // D6 - JDQ0
#define RELAY2_PIN 13  // D7 - JDQ1  
#define RELAY3_PIN 14  // D5 - JDQ2
#define RELAY4_PIN 16  // D0 - JDQ3

// 涓插彛寮曡剼瀹氫箟
#define DEBUG_RX 3   // RXD0
#define DEBUG_TX 1   // TXD0
#define RS485_RX 4  // D2 - RS485 RX (GPIO4)
#define RS485_TX 5  // D1 - RS485 TX (GPIO5)
// RS485妯″潡鑷姩鎺у埗鏂瑰悜锛屾棤闇€DE/RE绠¤剼

// 缃戠粶閰嶇疆
#define DEFAULT_SSID "SSKJ-4"
#define DEFAULT_PASSWORD "xszn486020zcs"
#define AP_NAME "ESP8266-RelayCtrl"
#define AP_PASSWORD "12345678"

// MQTT閰嶇疆
#define MQTT_BROKER "192.168.1.100"
#define MQTT_PORT 1883
#define MQTT_CLIENT_ID "ESP8266_RelayCtrl"
#define MQTT_TOPIC_BASE "relay/"

// Modbus閰嶇疆
#define MODBUS_SLAVE_ID 1
#define MODBUS_BAUD 9600

// EEPROM鍦板潃瀹氫箟
#define EEPROM_SIZE 512
#define WIFI_SSID_ADDR 0
#define WIFI_PASS_ADDR 64
#define MQTT_SERVER_ADDR 128
#define MQTT_PORT_ADDR 192
#define DEVICE_ID_ADDR 196

// 鍏ㄥ眬瀵硅薄
ESP8266WebServer server(80);
ESP8266HTTPUpdateServer httpUpdater;
WiFiClient wifiClient;
PubSubClient mqttClient(wifiClient);
SoftwareSerial rs485Serial(RS485_RX, RS485_TX);
ModbusMaster modbus;

// TCP鏈嶅姟鍣ㄥ璞?WiFiServer modbusServer(502);  // Modbus TCP绔彛
WiFiServer rawTcpServer(8080); // 鍘熷TCP绔彛

// 鍏ㄥ眬鍙橀噺
bool relayStates[4] = {false, false, false, false};
String deviceId = "ESP8266_001";
String mqttServer = MQTT_BROKER;
int mqttPort = MQTT_PORT;
unsigned long lastMqttReconnect = 0;
unsigned long lastHeartbeat = 0;

RelayConfig config;

void setup() {
  Serial.begin(115200);
  Serial.println("\n=== ESP8266 4-Channel Relay Controller ===");
  Serial.println("Version: 1.0.0");
  Serial.println("Device: JDQ0-3 Relay Control");
  
  // 鍒濆鍖朎EPROM
  EEPROM.begin(EEPROM_SIZE);
  loadConfig();
  
  // 鍒濆鍖栫户鐢靛櫒寮曡剼
  initRelays();
  
  // 鍒濆鍖栦覆鍙ｉ€氫俊
  initSerialPorts();
  
  // 鍒濆鍖朩iFi
  initWiFi();
  
  // 鍒濆鍖栫綉缁滄湇鍔?  initWebServer();
  initMQTT();
  initModbus();
  initTcpServers();
  
  // 鍒濆鍖杕DNS
  if (MDNS.begin("esp8266-relay")) {
    Serial.println("mDNS responder started");
    MDNS.addService("http", "tcp", 80);
  }
  
  Serial.println("System initialized successfully!");
  printSystemInfo();
}

void loop() {
  // 浼樺厛澶勭悊Web鏈嶅姟鍣ㄨ姹?  server.handleClient();
  
  // 闈欐€佸彉閲忕敤浜庢帶鍒跺叾浠栦换鍔＄殑鎵ц棰戠巼
  static unsigned long lastMqttCheck = 0;
  static unsigned long lastTcpCheck = 0;
  static unsigned long lastSerialCheck = 0;
  static unsigned long lastModbusCheck = 0;
  static unsigned long lastHeartbeat = 0;
  
  unsigned long currentTime = millis();
  
  // MQTT澶勭悊 - 闄嶄綆棰戠巼鍒版瘡500ms锛屼粎鍦ㄥ惎鐢ㄦ椂澶勭悊
  if (config.mqttEnabled && currentTime - lastMqttCheck > 500) {
    lastMqttCheck = currentTime;
    if (!mqttClient.connected()) {
      reconnectMQTT();
    }
    mqttClient.loop();
  }
  
  // TCP鏈嶅姟鍣ㄥ鐞?- 姣?00ms锛屼粎鍦ㄥ惎鐢ㄦ椂澶勭悊
  if ((config.tcpEnabled || config.modbusTcpEnabled) && currentTime - lastTcpCheck > 100) {
    lastTcpCheck = currentTime;
    handleTcpClients();
  }
  
  // 涓插彛鍛戒护澶勭悊 - 姣?0ms
  if (currentTime - lastSerialCheck > 50) {
    lastSerialCheck = currentTime;
    handleSerialCommands();
  }
  
  // Modbus澶勭悊 - 姣?0ms
  if (currentTime - lastModbusCheck > 50) {
    lastModbusCheck = currentTime;
    handleModbus();
  }
  
  // 蹇冭烦鍙戦€?- 姣?0绉掞紝浠呭湪MQTT鍚敤鏃跺彂閫?  if (config.mqttEnabled && currentTime - lastHeartbeat > 10000) {
    lastHeartbeat = currentTime;
    sendHeartbeat();
  }
  
  // mDNS鏇存柊 - 姣忔閮芥墽琛岋紝浣嗗緢杞婚噺
  MDNS.update();
  
  // 鐭殏寤惰繜锛屼絾浼樺厛鍝嶅簲Web璇锋眰
  yield(); // 璁╁嚭CPU缁橶iFi鏍?}

void initRelays() {
  Serial.println("Initializing relays...");
  
  // 缁х數鍣ㄤ綆鐢靛钩鍚稿悎锛屾墍浠IGH=鍏抽棴锛屽厛璁剧疆涓哄叧闂姸鎬侀伩鍏嶄笂鐢电灛闂村姩浣?  pinMode(RELAY1_PIN, OUTPUT);
  digitalWrite(RELAY1_PIN, HIGH);  // 绔嬪嵆鍏抽棴锛堥珮鐢靛钩锛?  
  pinMode(RELAY2_PIN, OUTPUT);
  digitalWrite(RELAY2_PIN, HIGH);  // 绔嬪嵆鍏抽棴锛堥珮鐢靛钩锛?  
  pinMode(RELAY3_PIN, OUTPUT);
  digitalWrite(RELAY3_PIN, HIGH);  // 绔嬪嵆鍏抽棴锛堥珮鐢靛钩锛?  
  pinMode(RELAY4_PIN, OUTPUT);
  digitalWrite(RELAY4_PIN, HIGH);  // 绔嬪嵆鍏抽棴锛堥珮鐢靛钩锛?  
  // 鍒濆鐘舵€佷负鍏抽棴锛堜笂鐢典繚鎸佸叧闂級
  for (int i = 0; i < 4; i++) {
    setRelay(i, false);
  }
  
  Serial.println("Relays initialized - All OFF");
}

void initSerialPorts() {
  Serial.println("Initializing serial ports...");
  
  // 璋冭瘯涓插彛宸插湪setup()涓垵濮嬪寲
  Serial.println("Debug serial: 115200 baud");
  
  // RS485涓插彛鍒濆鍖栵紙鑷姩鏂瑰悜鎺у埗锛?  rs485Serial.begin(MODBUS_BAUD);
  Serial.println("RS485 serial: 9600 baud");
}

void initWiFi() {
  Serial.println("Initializing WiFi...");
  
  WiFiManager wifiManager;
  wifiManager.setAPStaticIPConfig(IPAddress(192,168,4,1), IPAddress(192,168,4,1), IPAddress(255,255,255,0));
  
  // 棣栧厛灏濊瘯杩炴帴榛樿WiFi (SSKJ-4)
  WiFi.begin(DEFAULT_SSID, DEFAULT_PASSWORD);
  Serial.print("Connecting to default WiFi: ");
  Serial.println(DEFAULT_SSID);
  Serial.print("WiFi password: ");
  Serial.println(DEFAULT_PASSWORD);
  
  // 绛夊緟杩炴帴锛岃秴鏃跺悗鍚姩閰嶇綉
  int timeout = 30; // 澧炲姞瓒呮椂鏃堕棿鍒?0绉?  while (WiFi.status() != WL_CONNECTED && timeout > 0) {
    delay(1000);
    Serial.print(".");
    timeout--;
    
    // 姣?0绉掓樉绀轰竴娆iFi鐘舵€?    if (timeout % 10 == 0) {
      Serial.print("\nWiFi Status: ");
      Serial.print(WiFi.status());
      Serial.print(" (");
      switch(WiFi.status()) {
        case WL_IDLE_STATUS: Serial.print("IDLE"); break;
        case WL_NO_SSID_AVAIL: Serial.print("NO_SSID_AVAIL"); break;
        case WL_SCAN_COMPLETED: Serial.print("SCAN_COMPLETED"); break;
        case WL_CONNECTED: Serial.print("CONNECTED"); break;
        case WL_CONNECT_FAILED: Serial.print("CONNECT_FAILED"); break;
        case WL_CONNECTION_LOST: Serial.print("CONNECTION_LOST"); break;
        case WL_DISCONNECTED: Serial.print("DISCONNECTED"); break;
        default: Serial.print("UNKNOWN"); break;
      }
      Serial.println(")");
    }
  }
  
  if (WiFi.status() == WL_CONNECTED) {
    Serial.println("\nWiFi connected!");
    Serial.print("IP address: ");
    Serial.println(WiFi.localIP());
    Serial.print("MAC address: ");
    Serial.println(WiFi.macAddress());
    Serial.print("Signal strength: ");
    Serial.print(WiFi.RSSI());
    Serial.println(" dBm");
    return; // 杩炴帴鎴愬姛锛岄€€鍑哄嚱鏁?  }
  
  // 濡傛灉榛樿WiFi杩炴帴澶辫触锛屽皾璇曞凡淇濆瓨鐨勯厤缃?  if (strlen(config.ssid) > 0 && strcmp(config.ssid, DEFAULT_SSID) != 0) {
    Serial.print("\nTrying saved WiFi: ");
    Serial.println(config.ssid);
    WiFi.begin(config.ssid, config.password);
    
    timeout = 20;
    while (WiFi.status() != WL_CONNECTED && timeout > 0) {
      delay(1000);
      Serial.print(".");
      timeout--;
    }
  }
  
  if (WiFi.status() != WL_CONNECTED) {
    Serial.println("\nDefault WiFi connection failed!");
    Serial.print("Final WiFi Status: ");
    Serial.print(WiFi.status());
    Serial.print(" (");
    switch(WiFi.status()) {
      case WL_NO_SSID_AVAIL: Serial.print("NO_SSID_AVAIL - Network not found"); break;
      case WL_CONNECT_FAILED: Serial.print("CONNECT_FAILED - Wrong password"); break;
      case WL_CONNECTION_LOST: Serial.print("CONNECTION_LOST"); break;
      case WL_DISCONNECTED: Serial.print("DISCONNECTED"); break;
      default: Serial.print("OTHER"); break;
    }
    Serial.println(")");
    
    Serial.println("Starting AP mode...");
    Serial.println("Please connect to ESP8266-RelayCtrl hotspot and configure WiFi");
    wifiManager.autoConnect(AP_NAME, AP_PASSWORD);
  }
}

void initWebServer() {
  Serial.println("Initializing web server...");
  
  // 涓婚〉
  server.on("/", handleRoot);
  
  // API绔偣
  server.on("/api/status", handleStatus);
  server.on("/api/relay", HTTP_POST, handleRelayControl);
  server.on("/api/config", HTTP_GET, handleGetConfig);
  server.on("/api/config", HTTP_POST, handleSetConfig);
  server.on("/api/restart", HTTP_POST, handleRestart);
  server.on("/api/protocol", HTTP_POST, handleProtocolControl); // 鏂板鍗忚鎺у埗
  
  // OTA鏇存柊
  httpUpdater.setup(&server, "/update", "admin", "admin");
  
  server.begin();
  Serial.println("Web server started on port 80");
}

void initMQTT() {
  Serial.println("Initializing MQTT...");
  
  mqttClient.setServer(config.mqttServer, config.mqttPort);
  mqttClient.setCallback(mqttCallback);
  
  Serial.print("MQTT server: ");
  Serial.print(config.mqttServer);
  Serial.print(":");
  Serial.println(config.mqttPort);
}

void initModbus() {
  Serial.println("Initializing Modbus...");
  
  modbus.begin(MODBUS_SLAVE_ID, rs485Serial);
  Serial.print("Modbus slave ID: ");
  Serial.println(MODBUS_SLAVE_ID);
}

void setRelay(int relay, bool state) {
  if (relay < 0 || relay > 3) return;
  
  relayStates[relay] = state;
  
  int pin;
  switch (relay) {
    case 0: pin = RELAY1_PIN; break;
    case 1: pin = RELAY2_PIN; break;
    case 2: pin = RELAY3_PIN; break;
    case 3: pin = RELAY4_PIN; break;
  }
  
  // 缁х數鍣ㄤ綆鐢靛钩鍚稿悎锛圠OW=ON, HIGH=OFF锛?  digitalWrite(pin, state ? LOW : HIGH);
  
  Serial.print("Relay ");
  Serial.print(relay + 1);
  Serial.print(" (JDQ");
  Serial.print(relay);
  Serial.print("): ");
  Serial.println(state ? "ON" : "OFF");
  
  // 鍙戦€丮QTT鐘舵€佹洿鏂?  publishRelayState(relay, state);
}

void loadConfig() {
  Serial.println("Loading configuration...");
  
  // 妫€鏌ラ厤缃湁鏁堟€ф爣蹇?  if (EEPROM.read(EEPROM_SIZE - 1) != 0xAA) {
    Serial.println("No valid config found, using defaults");
    setDefaultConfig();
    return;
  }
  
  // 璇诲彇閰嶇疆
  for (int i = 0; i < 32; i++) {
    config.ssid[i] = EEPROM.read(WIFI_SSID_ADDR + i);
  }
  for (int i = 0; i < 64; i++) {
    config.password[i] = EEPROM.read(WIFI_PASS_ADDR + i);
  }
  for (int i = 0; i < 64; i++) {
    config.mqttServer[i] = EEPROM.read(MQTT_SERVER_ADDR + i);
  }
  
  config.mqttPort = EEPROM.read(MQTT_PORT_ADDR) | (EEPROM.read(MQTT_PORT_ADDR + 1) << 8);
  
  for (int i = 0; i < 32; i++) {
    config.deviceId[i] = EEPROM.read(DEVICE_ID_ADDR + i);
  }
  
  config.valid = true;
  
  Serial.println("Configuration loaded successfully");
}

void setDefaultConfig() {
  strcpy(config.ssid, DEFAULT_SSID);
  strcpy(config.password, DEFAULT_PASSWORD);
  strcpy(config.mqttServer, MQTT_BROKER);
  config.mqttPort = MQTT_PORT;
  strcpy(config.deviceId, "ESP8266_001");
  config.mqttEnabled = true;      // 榛樿鍚敤MQTT
  config.tcpEnabled = true;       // 榛樿鍚敤TCP
  config.modbusTcpEnabled = true; // 榛樿鍚敤Modbus TCP
  config.valid = true;
  
  saveConfig();
}

void saveConfig() {
  Serial.println("Saving configuration...");
  
  // 鍐欏叆WiFi閰嶇疆
  for (int i = 0; i < 32; i++) {
    EEPROM.write(WIFI_SSID_ADDR + i, config.ssid[i]);
  }
  for (int i = 0; i < 64; i++) {
    EEPROM.write(WIFI_PASS_ADDR + i, config.password[i]);
  }
  
  // 鍐欏叆MQTT閰嶇疆
  for (int i = 0; i < 64; i++) {
    EEPROM.write(MQTT_SERVER_ADDR + i, config.mqttServer[i]);
  }
  EEPROM.write(MQTT_PORT_ADDR, config.mqttPort & 0xFF);
  EEPROM.write(MQTT_PORT_ADDR + 1, (config.mqttPort >> 8) & 0xFF);
  
  // 鍐欏叆璁惧ID
  for (int i = 0; i < 32; i++) {
    EEPROM.write(DEVICE_ID_ADDR + i, config.deviceId[i]);
  }
  
  // 鍐欏叆鏈夋晥鎬ф爣蹇?  EEPROM.write(EEPROM_SIZE - 1, 0xAA);
  
  EEPROM.commit();
  Serial.println("Configuration saved");
}

void printSystemInfo() {
  Serial.println("\n=== System Information ===");
  Serial.print("Device ID: ");
  Serial.println(config.deviceId);
  Serial.print("WiFi SSID: ");
  Serial.println(WiFi.SSID());
  Serial.print("IP Address: ");
  Serial.println(WiFi.localIP());
  Serial.print("MAC Address: ");
  Serial.println(WiFi.macAddress());
  Serial.print("MQTT Server: ");
  Serial.print(config.mqttServer);
  Serial.print(":");
  Serial.println(config.mqttPort);
  Serial.println("========================\n");
}

// 鍗忚鎺у埗鍑芥暟瀹炵幇
void enableMQTT(bool enable) {
  config.mqttEnabled = enable;
  if (enable) {
    startMQTT();
  } else {
    stopMQTT();
  }
  saveConfig();
}

void enableTCP(bool enable) {
  config.tcpEnabled = enable;
  if (enable) {
    startTCP();
  } else {
    stopTCP();
  }
  saveConfig();
}

void enableModbusTCP(bool enable) {
  config.modbusTcpEnabled = enable;
  if (enable) {
    startModbusTCP();
  } else {
    stopModbusTCP();
  }
  saveConfig();
}

void startMQTT() {
  Serial.println("Starting MQTT...");
  mqttClient.setServer(config.mqttServer, config.mqttPort);
  mqttClient.setCallback(mqttCallback);
}

void stopMQTT() {
  Serial.println("Stopping MQTT...");
  if (mqttClient.connected()) {
    mqttClient.disconnect();
  }
}

void startTCP() {
  Serial.println("Starting raw TCP server...");
  rawTcpServer.begin();
}

void stopTCP() {
  Serial.println("Stopping raw TCP server...");
  rawTcpServer.stop();
}

void startModbusTCP() {
  Serial.println("Starting Modbus TCP server...");
  modbusServer.begin();
}

void stopModbusTCP() {
  Serial.println("Stopping Modbus TCP server...");
  modbusServer.stop();
}
